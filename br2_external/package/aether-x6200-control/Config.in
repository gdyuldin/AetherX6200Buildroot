## br2_external/package/aether-x6200-control/Config.in
```kconfig
config BR2_PACKAGE_AETHER_X6200_CONTROL
	bool "aether_x6200_control"
	depends on BR2_LINUX_KERNEL
	help
	  Aether-Radio's X6200 base control library
```

## br2_external/package/ft8lib/Config.in
```kconfig
config BR2_PACKAGE_FT8LIB
	bool "ft8lib"
	depends on BR2_LINUX_KERNEL
	help
	  FT8 lib package to encode/decode FT8/FT4
```

## br2_external/package/x6100-gui/Config.in
```kconfig
config BR2_PACKAGE_X6100_GUI
	bool "x6100_gui"
	depends on BR2_PACKAGE_AETHER_X6100_CONTROL
	depends on BR2_PACKAGE_RHVOICE
	depends on BR2_PACKAGE_LIBPNG
	help
	  X6100 GUI application
```

## br2_external/package/x6200-gui/Config.in
```kconfig
config BR2_PACKAGE_X6200_GUI
	bool "x6200_gui"
	select BR2_PACKAGE_LIBPNG
	select BR2_PACKAGE_AETHER_X6200_CONTROL
	select BR2_PACKAGE_RHVOICE
	select BR2_PACKAGE_FT8LIB
	help
	  X6200 GUI application
```
